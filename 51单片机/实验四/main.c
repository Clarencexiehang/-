#include<reg52.h>
#include<intrins.h>

#define uchar unsigned char 
#define uint unsigned int
sbit BEEP=P1^0; //定义喇叭输出端口
uchar tick,tl,th; //定义节拍和TO初值变量


uchar TABLE[]={ //音符节拍码表
	0x82, 0x01, 0x81, 0x94, 0x84, 0xB4, 0xA4, 0x04,
	0x82, 0x01, 0x81, 0x94, 0x84, 0xC4, 0xB4, 0x04,
	0x82, 0x01, 0x81, 0xF4, 0xD4, 0xB4, 0xA4, 0x94,
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	0xE2, 0x01, 0xE1, 0xD4, 0xB4, 0xC4, 0xB4, 0x04,
	0x00};


uchar TABLE1[]={ //音符对应的定时器初值表
	0xfb, 0x04, 0xfb, 0x90, 0xfc, 0x09, 0xfc,0x44,
	0xfc, 0xac, 0xfd, 0x09, 0xfd, 0x34,0xfd, 0x82,
	0xfd, 0xc8, 0xfe, 0x06, 0xfe, 0x22,0xfe, 0x56,
	0xfe, 0x85, 0xfe, 0x9a, 0xfe, 0xc1};

/*TO中断服务函数*/
timer0 ()interrupt 1 using 1{  //重装定时初值
	TL0=tl; TH0=th;
	BEEP=~ BEEP; 	//喇叭输出端口电平取反
}


void delay1 () {
	uint i;
	for(i=0;i<20000;i++);
}

void delay(tt) {
	uchar i;
	for(i=0;i<=tt;i++) 
	delay1();
}


void main(){
	uchar t,t1,k=0; //定义临时变量
	while(1) {
		TMOD=0x01; IE=0x82; //定义T0工作方式，开中断
		while (TABLE[k]!=0) { //判断取得的音符节拍码是否为结束码
			tick= (TABLE[k]) &0x0f; //不是，则取节拍码0[81-8阅)
			t=(_crol_(TABLE[k],4))&0x0f;  //取音符码
			if(t!=0){ //判断取得的音符码是否为0
				t1=--t*2+1; //不是，则根据取得的音符码计算TO初值
				t=t*2;
				tl=TL0=TABLE1[t1];
				th=TH0=TABLE1[t];
				TR0=1; //启动T0
			}
			else TR0=0; //取得的音符码为0,则停止TO 
			delay(tick); //根据则取得的节拍码延时
			k++;
		}
		TR0=0; //取得结束码，则停止TO
	}
}

 











